#pragma once
// SSD1306 128x64 I2C driver with a frame buffer.
// Based on SSD1306Fast from ~/oled_wled (same init sequence and pin scan),
// extended with a full printable-ASCII 5x7 font and 2x text.

#include "platform.h"
#include "driver/i2c.h"
#include "driver/gpio.h"

class Oled {
public:
  static constexpr int W = 128, H = 64, BUF = W * H / 8;
  uint8_t buf[BUF];
  uint8_t addr = 0x3C;
  int sda = 22, scl = 23;
  bool ok = false;
  bool installed = false;

  // Tries the given pins first, then common SDA/SCL pairs.
  bool begin(int sdaPin, int sclPin, uint32_t hz) {
    struct Pair { int sda, scl; };
    const Pair pairs[] = {{sdaPin, sclPin}, {21, 22}, {22, 21}, {22, 23}, {23, 22},
                          {4, 15}, {15, 4}, {5, 4}, {4, 5}, {18, 19}, {19, 18}};
    for (const Pair& p : pairs) {
      if (probe(p.sda, p.scl, 100000)) {
        sda = p.sda;
        scl = p.scl;
        ok = true;
        break;
      }
    }
    if (!ok) { uninstall(); return false; }
    uint8_t dummy;
    if (!probe(sda, scl, hz, &dummy)) probe(sda, scl, 100000, &dummy);

    static const uint8_t init[] = {
      0xAE, 0xD5, 0xF0, 0xA8, 0x3F, 0xD3, 0x00, 0x40, 0x8D, 0x14, 0x20, 0x00,
      0xA1, 0xC8, 0xDA, 0x12, 0x81, 0xFF, 0xD9, 0xF1, 0xDB, 0x40, 0xA4, 0xA6, 0xAF};
    for (uint8_t c : init) cmd(c);
    clear();
    display();
    return true;
  }

  void clear() { memset(buf, 0, BUF); }

  inline void px(int x, int y, bool on = true) {
    if ((unsigned)x >= W || (unsigned)y >= H) return;
    uint8_t m = 1 << (y & 7);
    if (on) buf[x + (y >> 3) * W] |= m;
    else buf[x + (y >> 3) * W] &= ~m;
  }

  void hline(int x0, int x1, int y, bool on = true) {
    if (x0 > x1) { int t = x0; x0 = x1; x1 = t; }
    for (int x = x0; x <= x1; x++) px(x, y, on);
  }

  void vline(int x, int y0, int y1, bool on = true) {
    if ((unsigned)x >= W) return;
    if (y0 > y1) { int t = y0; y0 = y1; y1 = t; }
    if (y0 < 0) y0 = 0;
    if (y1 >= H) y1 = H - 1;
    for (int y = y0; y <= y1; y++) px(x, y, on);
  }

  void line(int x0, int y0, int x1, int y1, bool on = true) {
    if (x0 == x1) { vline(x0, y0, y1, on); return; }
    int dx = abs(x1 - x0), sx = x0 < x1 ? 1 : -1;
    int dy = -abs(y1 - y0), sy = y0 < y1 ? 1 : -1;
    int err = dx + dy;
    for (;;) {
      px(x0, y0, on);
      if (x0 == x1 && y0 == y1) break;
      int e2 = 2 * err;
      if (e2 >= dy) { err += dy; x0 += sx; }
      if (e2 <= dx) { err += dx; y0 += sy; }
    }
  }

  void fill(int x, int y, int w, int h, bool on = true) {
    for (int yy = y; yy < y + h; yy++)
      for (int xx = x; xx < x + w; xx++) px(xx, yy, on);
  }

  void rect(int x, int y, int w, int h, bool on = true) {
    hline(x, x + w - 1, y, on);
    hline(x, x + w - 1, y + h - 1, on);
    vline(x, y, y + h - 1, on);
    vline(x + w - 1, y, y + h - 1, on);
  }

  // 6 px per character at scale 1 (5 px glyph + 1 px gap), 8 px tall
  int textWidth(const char* s, int scale = 1) { return (int)strlen(s) * 6 * scale; }

  void text(int x, int y, const char* s, bool on = true, int scale = 1) {
    for (; *s; s++, x += 6 * scale) glyphAt(x, y, (uint8_t)*s, on, scale);
  }

  // inverse-video label (black text on a white box)
  void textInv(int x, int y, const char* s) {
    fill(x - 1, y - 1, textWidth(s) + 1, 9, true);
    text(x, y, s, false);
  }

  void display() {
    static const uint8_t win[] = {0x00, 0x21, 0, W - 1, 0x22, 0, H / 8 - 1};
    i2c_master_write_to_device(I2C_NUM_0, addr, win, sizeof(win), pdMS_TO_TICKS(20));
    i2c_cmd_handle_t c = i2c_cmd_link_create();
    i2c_master_start(c);
    i2c_master_write_byte(c, (addr << 1) | I2C_MASTER_WRITE, true);
    i2c_master_write_byte(c, 0x40, true);
    i2c_master_write(c, buf, BUF, true);
    i2c_master_stop(c);
    i2c_master_cmd_begin(I2C_NUM_0, c, pdMS_TO_TICKS(60));
    i2c_cmd_link_delete(c);
  }

private:
  void cmd(uint8_t c) {
    uint8_t pkt[2] = {0x00, c};
    i2c_master_write_to_device(I2C_NUM_0, addr, pkt, 2, pdMS_TO_TICKS(20));
  }

  void uninstall() {
    if (installed) i2c_driver_delete(I2C_NUM_0);
    installed = false;
  }

  bool probe(int sdaPin, int sclPin, uint32_t hz, uint8_t* found = nullptr) {
    uninstall();
    i2c_config_t conf = {};
    conf.mode = I2C_MODE_MASTER;
    conf.sda_io_num = (gpio_num_t)sdaPin;
    conf.scl_io_num = (gpio_num_t)sclPin;
    conf.sda_pullup_en = GPIO_PULLUP_ENABLE;
    conf.scl_pullup_en = GPIO_PULLUP_ENABLE;
    conf.master.clk_speed = hz;
    if (i2c_param_config(I2C_NUM_0, &conf) != ESP_OK) return false;
    if (i2c_driver_install(I2C_NUM_0, conf.mode, 0, 0, 0) != ESP_OK) return false;
    installed = true;
    for (uint8_t a : {0x3C, 0x3D}) {
      i2c_cmd_handle_t c = i2c_cmd_link_create();
      i2c_master_start(c);
      i2c_master_write_byte(c, (a << 1) | I2C_MASTER_WRITE, true);
      i2c_master_stop(c);
      esp_err_t e = i2c_master_cmd_begin(I2C_NUM_0, c, pdMS_TO_TICKS(25));
      i2c_cmd_link_delete(c);
      if (e == ESP_OK) {
        addr = a;
        if (found) *found = a;
        return true;
      }
    }
    // the bus stays installed on the last probed pins
    gpio_reset_pin((gpio_num_t)sdaPin);
    gpio_reset_pin((gpio_num_t)sclPin);
    return false;
  }

  static const uint8_t* glyph(uint8_t c) {
    static const uint8_t font[95][5] = {
      {0x00,0x00,0x00,0x00,0x00},{0x00,0x00,0x5F,0x00,0x00},{0x00,0x07,0x00,0x07,0x00},{0x14,0x7F,0x14,0x7F,0x14}, //  !"#
      {0x24,0x2A,0x7F,0x2A,0x12},{0x23,0x13,0x08,0x64,0x62},{0x36,0x49,0x55,0x22,0x50},{0x00,0x05,0x03,0x00,0x00}, // $%&'
      {0x00,0x1C,0x22,0x41,0x00},{0x00,0x41,0x22,0x1C,0x00},{0x08,0x2A,0x1C,0x2A,0x08},{0x08,0x08,0x3E,0x08,0x08}, // ()*+
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      {0x00,0x00,0x7F,0x00,0x00},{0x00,0x41,0x36,0x08,0x00},{0x10,0x08,0x08,0x10,0x08},                            // |}~
    };
    static const uint8_t up[5] = {0x04, 0x02, 0x7F, 0x02, 0x04};
    static const uint8_t down[5] = {0x10, 0x20, 0x7F, 0x20, 0x10};
    if (c == 0x18) return up;
    if (c == 0x19) return down;
    if (c < 0x20 || c > 0x7E) c = '?';
    return font[c - 0x20];
  }

  void glyphAt(int x, int y, uint8_t c, bool on, int scale) {
    const uint8_t* g = glyph(c);
    for (int col = 0; col < 5; col++)
      for (int row = 0; row < 8; row++)
        if (g[col] & (1 << row)) {
          if (scale == 1) px(x + col, y + row, on);
          else fill(x + col * scale, y + row * scale, scale, scale, on);
        }
  }
};
